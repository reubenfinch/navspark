#include "binmsg.h"

//

#ifdef __cplusplus
extern "C" {
#endif
uint8_t v8_nonGnss_image_download_process(const unsigned char *buf, uint8_t id, const char *binarray, uint32_t size);
#ifdef __cplusplus
}
#endif


BinaryParser::BinaryParser()
{
  ClearInBuffer();
  ClearLineBuffer();
}

void BinaryParser::OrganizeInBuffer()
{
  if(inBufferPtr==0)
    return;
  if(inBufferPtr == inBufferLen)
  {
    ClearInBuffer();
    return;
  }

  int trueLen = inBufferLen-inBufferPtr;
  for(int i=0; i<trueLen; ++i)
  {
    inBuffer[i] = inBuffer[inBufferPtr];
    ++inBufferPtr;
  }
  inBufferLen = trueLen;
  inBufferPtr = 0;
}

int BinaryParser::ReadOneLine()
{
  U08* bufferIter = lineBuffer;
  int totalSize = 0;
  int bkInPtr = inBufferPtr;
  if(inBufferLen == 0)
  {
    return 0;
  }

  while(totalSize < LineBufferSize - 1)
  { 
    if(inBufferLen == inBufferPtr) 
    { //No new line until inBuffer end, return and restore inBufferPtr
      inBufferPtr = bkInPtr;
      return 0;
    }
    
    int bytesInBuff = inBufferLen - inBufferPtr;
    while(bytesInBuff)
    {
      *bufferIter = inBuffer[inBufferPtr];
      ++inBufferPtr;
      ++totalSize;
      if(totalSize > 1)
      { //not first char.
        if(*bufferIter == 0x0A && *(bufferIter - 1) == 0x0D)
        { //finished read one line
          OrganizeInBuffer();
          return totalSize - 2; //return length without 0x0d,0x0a
        }
      }

      if (totalSize ==  LineBufferSize - 1)
      { //Line buffer full
        *(bufferIter+1) = 0;
        OrganizeInBuffer();
        return totalSize;
      }
      ++bufferIter;
      --bytesInBuff;
    } //while(bytesinbuff)
  }
  return 0;
}

BinType BinaryParser::BinaryDataIn(U08* buf, int size)
{
  if(inBufferLen + size > InBufferSize)
  { //Buffer full, clear burrer and doesn't parse.
    ClearInBuffer();
    memcpy(inBuffer, buf, size);
    inBufferLen = size;
    return MSG_FULL;
  }
  
  memcpy(inBuffer + inBufferLen, buf, size);
  
  inBufferLen += size;
  int r = ReadOneLine();
  
  if(r==0)
  {
    return MSG_UNKNOWN;
  }
  
  lineLen = r;
  BinType t = MessageType((const unsigned char*)lineBuffer, lineLen);

  return t;
}
extern int _fini;
extern int _edata;
U08 BinaryParser::BMSG_reply_sw_crc(U08 *buf, U08 type)
{
  U16 crc=0;
  U32 i,j;
  U32 addrtxt, addrdata, size;
  U08 offset;
  addrtxt = (U32)&_fini;
  addrdata = (U32)&_edata;
  //check the alignment
  U08 tmp;
  tmp=(addrtxt+20) % 16;
  if(tmp==0)
  offset=20;
  else
  offset = 16-tmp+20;
  //size = addrtxt +offset + (addrdata-0x60000000);
  size = addrtxt +offset + (addrdata&0x000FFFFF);
  for(j=0;j<size;j++)
  crc = crc+ *(volatile unsigned char *)(0x0+j);


    for(i=j;i<(FLASH_CHIP_SIZE*2);i++)
    crc = crc+ 0xff;


  buf[1] = type;
  buf[2] = crc>>8;
  buf[3] = crc & 0xff;

  return TRUE;
}

U08 BinaryParser::BMSG_cfg_query_sw_crc(const unsigned char *buf, U08 *repbuf)
{
  U08 sw_type;
  sw_type = buf[0];
  if((sw_type==0)||(sw_type==1))
  {
      BMSG_reply_sw_crc(repbuf, sw_type);
      return TRUE;
  }
  else
  return FALSE;
}

U08 BinaryParser::BMSG_cal_checksum(U08 *buf, U16 len)
{
  U08 checksum=0;
  U16 i;
  for(i=0;i<len;i++)
  {
    checksum=buf[i]^checksum;
  }
    return checksum;
}

U16 BinaryParser::BMSG_PackMsg( U08 *ibuf, U08 *obuf, U16 len )
{
  U08 checksum;
  U16  pkcnt = 0;
  checksum=BMSG_cal_checksum(ibuf,len);
  // header
  obuf[pkcnt++] = SOS1;
  obuf[pkcnt++] = SOS2;
  obuf[pkcnt++] = len>>8;
  obuf[pkcnt++] = len&0xff;
  while( len-- )
    obuf[pkcnt++] = *ibuf++;;
  obuf[pkcnt++] = checksum;
  obuf[pkcnt++] = EOS1;
  obuf[pkcnt++] = EOS2;
  return( pkcnt );
}

void BinaryParser::BMSG_CmdReply( U08 msgID, U08 reqID)
{
  U16  len;
  U08    msg[256], out[256];

  memset(msg, 0, sizeof(msg));
  msg[0]=msgID;
  msg[1]=reqID;
  len = 2;
  len = BMSG_PackMsg( msg, out, len );
  
  Serial1.write((uint8_t *)(out),len);


}

void BinaryParser::BMSG_MsgReply(U08 msgID, U08 *buf, U08 len)
{
  U08  out[256];
  buf[0]=msgID;
  len = BMSG_PackMsg( buf, out, len );

  
  Serial1.write((uint8_t *)(out),len);

}


const char binarray[]={0x3,0x0,0x0,0x8,0x82,0x10,0x61,0x18,0x9c,0x23,0x80,0x1,0xfe,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0x0,0x0};



U08 BinaryParser::BMSG_new_image_download(const unsigned char *buf, U08 id)
{

  
  if(v8_nonGnss_image_download_process(buf, id, binarray, sizeof(binarray))== FALSE)
  return FALSE;
  else
  return TRUE;
}

BinType BinaryParser::MessageType(LPCSTR pt, int len)
{
	int msg_len;
//	U08 buf[100];
	U08 reqID=(U08) pt[4];
	msg_len=(pt[2]<<8) | (pt[3]);	
  if((pt[0]!=SOS1)||(pt[1]!=SOS2)||(msg_len!=(len-5)))
  return MSG_ERROR;
  if(!VarifyBinaryChecksum(pt, len))
  {

    BMSG_CmdReply( REPLY_NACK, reqID);
    return MSG_ERROR;
  }

  U08 repbuf[256];
  U16 mlen = 0;
  U08 retval=FALSE;
  U08 respID=0;
  
	switch (reqID)
	{
     
     case SET_QUERY_SW_CRC:
          retval=BMSG_cfg_query_sw_crc(&(pt[5]), repbuf);
          mlen=4;
          respID=REPLY_SW_CRC;
     break;
     case SET_IMAGE_DOWNLOAD:          
          retval=BMSG_new_image_download(&(pt[5]), SET_IMAGE_DOWNLOAD);
     break;
     default:
     break;
     
   }
  BinType returnType;
	if(retval==TRUE)
	{
	
		BMSG_CmdReply( REPLY_ACK, reqID);
		if(respID!=0)
		{

			BMSG_MsgReply( respID, repbuf, mlen);
		}
		returnType = MSG_OK;
	}
	else
	{
    BMSG_CmdReply( REPLY_NACK, reqID);
    returnType = MSG_ERROR;
  }
  
  return returnType;
}

void BinaryParser::ClearInBuffer()
 {
  memset(inBuffer, 0, sizeof(inBuffer));
  inBufferLen = 0;
  inBufferPtr = 0;
 }
 
void BinaryParser::ClearLineBuffer()
{
  memset(lineBuffer, 0, sizeof(lineBuffer));
  lineLen = 0;
}

int BinaryParser::VarifyBinaryChecksum(LPCSTR pt, int len)
{
  U08 checksum;  
  
  checksum=BMSG_cal_checksum((U08 *)&(pt[4]), len-5);

  return checksum == pt[len-1];
}
